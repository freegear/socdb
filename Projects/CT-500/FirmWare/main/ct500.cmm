reset
system.cpu arm926ej
;system.jtagclock 8Mhz
system.jtagclock RTCK
system.up
register.reset
; PMU Setting
;;data.set 0x50003000 %long 0x00001700
;;data.set 0x50003004 %long 0x00000000	; CPU 2X mode
;;data.set 0x50003004 %long 0x00000010	; CPU 1X mode
data.set 0x50003008 %long 0x80000380
data.set 0x5000300C %long 0x0000252a
data.set 0x50003010 %long 0x000FFFFC
;data.set 0x50003000 %long 0xFFFFFFFC
data.set 0x40004000 %long 0x00037535 
data.set 0x40004004 %long 0xA1    
data.set 0x4000400C %long 0x410   
data.set 0x40004010 %long 0x24    
data.load ./ct500_Data/Debug/ct500.axf
data.list
;symbol.browse.symbol






