## IPs/openrisc/or1k/orp/orp_soc/sw/uclinux/uclinux/uClinux-2.0.x/arch/armnommu/config.in
```kconfig
#
# For a description of the syntax of this configuration file,
# see the Configure script.
#
mainmenu_name "Linux kernel configuration"

define_bool CONFIG_ARM y
define_bool CONFIG_UCLINUX y

mainmenu_option next_comment
comment 'Code maturity level options'
bool 'Prompt for development and/or incomplete code/drivers' CONFIG_EXPERIMENTAL
endmenu

mainmenu_option next_comment
comment 'Loadable module support'
bool 'Enable loadable module support' CONFIG_MODULES
if [ "$CONFIG_MODULES" = "y" ]; then
  bool 'Set version information on all symbols for modules' CONFIG_MODVERSIONS
  bool 'Kernel daemon support (e.g. autoload of modules)' CONFIG_KERNELD
fi
endmenu

mainmenu_option next_comment
comment 'General setup'
choice 'ARM system type'	\
	"AplioTrio		CONFIG_ARCH_TRIO \
	 Archimedes		CONFIG_ARCH_ARC \
	 A5000			CONFIG_ARCH_A5K \
	 RiscPC			CONFIG_ARCH_RPC \
	 EBSA-110		CONFIG_ARCH_EBSA110 \
	 NexusPCI		CONFIG_ARCH_NEXUSPCI" AplioTrio
if [ "$CONFIG_ARCH_ARC" = "y" -o "$CONFIG_ARCH_A5K" = "y" -o "$CONFIG_ARCH_RPC" = "y" ]; then
  define_bool CONFIG_ARCH_ACORN y
else
  define_bool CONFIG_ARCH_ACORN n
fi
if [ "$CONFIG_ARCH_NEXUSPCI" = "y" ]; then
  define_bool CONFIG_PCI y
else
  define_bool CONFIG_PCI n
fi
if [ "$CONFIG_ARCH_NEXUSPCI" = "y" -o "$CONFIG_ARCH_EBSA110" = "y" ]; then
  define_bool CONFIG_CPU_SA110 y
else
  if [ "$CONFIG_ARCH_TRIO" = "y" ]; then
	 define_bool CONFIG_CPU_ARM7 y
  else
    if [ "$CONFIG_ARCH_A5K" = "y" ]; then
       define_bool CONFIG_CPU_ARM6 y
    else
     choice 'ARM cpu type'		\
	  "ARM2			CONFIG_CPU_ARM2 \
	   ARM3			CONFIG_CPU_ARM3 \
	   ARM6/7			CONFIG_CPU_ARM6 \
	   StrongARM		CONFIG_CPU_SA110" StrongARM
    fi
  fi
fi
bool 'Compile kernel with frame pointer (for useful debugging)' CONFIG_FRAME_POINTER
bool 'Use new compilation options (for GCC 2.8)' CONFIG_BINUTILS_NEW
bool 'Debug kernel errors' CONFIG_DEBUG_ERRORS
bool 'Networking support' CONFIG_NET
bool 'System V IPC' CONFIG_SYSVIPC
#tristate 'Kernel support for a.out binaries' CONFIG_BINFMT_AOUT
#tristate 'Kernel support for ELF binaries' CONFIG_BINFMT_ELF
define_bool CONFIG_KERNEL_ELF y

if [ "$CONFIG_EXPERIMENTAL" = "y" ]; then
#  tristate 'Kernel support for JAVA binaries' CONFIG_BINFMT_JAVA
  define_bool CONFIG_BINFMT_JAVA n
fi
endmenu

source arch/armnommu/drivers/block/Config.in

if [ "$CONFIG_NET" = "y" ]; then
  source net/Config.in
fi

mainmenu_option next_comment
comment 'SCSI support'

tristate 'SCSI support?' CONFIG_SCSI

if [ "$CONFIG_SCSI" != "n" ]; then
  source arch/armnommu/drivers/scsi/Config.in
fi
endmenu

if [ "$CONFIG_NET" = "y" ]; then
  mainmenu_option next_comment
  comment 'Network device support'

  bool 'Network device support?' CONFIG_NETDEVICES
  if [ "$CONFIG_NETDEVICES" = "y" ]; then
    source arch/armnommu/drivers/net/Config.in
  fi
  endmenu
fi

# mainmenu_option next_comment
# comment 'ISDN subsystem'
#
# tristate 'ISDN support' CONFIG_ISDN
# if [ "$CONFIG_ISDN" != "n" ]; then
#   source drivers/isdn/Config.in
# fi
# endmenu

source fs/Config.in

source arch/armnommu/drivers/char/Config.in

if [ "$CONFIG_ARCH_EBSA110" != "y" ]; then
  mainmenu_option next_comment
  comment 'Sound'

  tristate 'Sound support' CONFIG_SOUND
  if [ "$CONFIG_SOUND" != "n" ]; then
    source arch/armnommu/drivers/sound/Config.in
  fi
  endmenu
fi

mainmenu_option next_comment
comment 'Kernel hacking'

#bool 'Debug kmalloc/kfree' CONFIG_DEBUG_MALLOC
bool 'Kernel profiling support' CONFIG_PROFILE
if [ "$CONFIG_PROFILE" = "y" ]; then
  int ' Profile shift count' CONFIG_PROFILE_SHIFT 2
fi
endmenu
```

## IPs/openrisc/or1k/orp/orp_soc/sw/uclinux/uclinux/uClinux-2.0.x/arch/m68knommu/config.in
```kconfig
#
# For a description of the syntax of this configuration file,
# see the Configure script.
#
mainmenu_name 'uClinux/68k (w/o MMU) Kernel Configuration'

define_bool CONFIG_UCLINUX y

mainmenu_option next_comment
comment 'Code maturity level options'
bool 'Prompt for development and/or incomplete code/drivers' CONFIG_EXPERIMENTAL
endmenu

# mainmenu_option next_comment
# comment 'Loadable module support'
# bool 'Enable loadable module support' CONFIG_MODULES
# if [ "$CONFIG_MODULES" = "y" ]; then
#   bool 'Set version information on all symbols for modules' CONFIG_MODVERSIONS
#   bool 'Kernel daemon support (e.g. autoload of modules)' CONFIG_KERNELD
# fi
# endmenu


mainmenu_option next_comment
comment 'Platform dependant setup'

choice 'CPU' \
	"MC68000	CONFIG_M68000 \
	 MC68EN302	CONFIG_M68EN302 \
	 MC68328	CONFIG_M68328 \
         MC68EZ328	CONFIG_M68EZ328 \
	 MC68332	CONFIG_M68332 \
	 MC68360	CONFIG_M68360 \
	 MCF5206	CONFIG_M5206  \
         MCF5206e	CONFIG_M5206e \
         MCF5307	CONFIG_M5307  \
	 MCF5204	CONFIG_M5204" M68EZ328

comment 'Platform'

if [ "$CONFIG_M68328" = "y" ]; then
	bool 'Pilot 1000/5000, PalmPilot Personal/Pro, or PalmIII support' CONFIG_PILOT
	if [ "$CONFIG_PILOT" = "y" ]; then
		bool '(X)Copilot support' CONFIG_XCOPILOT_BUGS
	fi
fi

if [ "$CONFIG_M68EZ328" = "y" ]; then
	bool 'Motorola M68EZ328ADS Dev. Board support' CONFIG_M68EZ328ADS
	if [ "$CONFIG_M68EZ328ADS" = "y" ]; then
		bool 'Compile the kernel to be loaded in DRAM instead of FLASH' CONFIG_M68EZ328ADS_RAM
	fi
	bool 'ALMA Electronics board support' CONFIG_ALMA_ANS
	if [ "$CONFIG_ALMA_ANS" = "y" ]; then
		bool 'Compile the kernel to be loaded in DRAM instead of FLASH' CONFIG_ALMA_ANS_RAM
	fi
	bool 'uCsimm module support' CONFIG_UCSIMM
	bool 'PalmV support' CONFIG_PILOT

fi

if [ "$CONFIG_M68EN302" = "y" ]; then
	choice 'CLOCK' \
		"CLOCK_20MHz CONFIG_CLOCK_20MHz \
		 CLOCK_25MHz CONFIG_CLOCK_25MHz" CLOCK_25MHz

	bool 'Aplio/Pro or Aplio/Entrecote support' CONFIG_APLIO
 
	if [ "$CONFIG_APLIO" = "y" ]; then
		bool 'Aplio Pro' CONFIG_APLIO_PRO
		bool 'Aplio Entrecote' CONFIG_APLIO_ENTRECOTE
	fi
fi

if [ "$CONFIG_M68332" = "y" ]; then
	bool 'SHGLCore support' CONFIG_SHGLCORE
	if [ "$CONFIG_SHGLCORE" = "y" ]; then
		bool '2Meg SHGLCore' CONFIG_SHGLCORE_2MEG
	fi
fi

if [ "$CONFIG_M5204" = "y" ]; then
	define_bool CONFIG_COLDFIRE y
fi

if [ "$CONFIG_M5206" = "y" ]; then
	define_bool CONFIG_COLDFIRE y
	bool 'Arnewsh 5206 eval board support' CONFIG_ARNEWSH
fi

if [ "$CONFIG_M5206e" = "y" ]; then
	define_bool CONFIG_COLDFIRE y
	bool 'Cadre-III support' CONFIG_CADRE3
	bool 'eLITE-5206e support' CONFIG_ELITE
	if [ "$CONFIG_ELITE" = "y" ]; then	
		bool '    SRAM only eLITE-5206e support' CONFIG_SMALL
	fi
	bool 'Moreton Bay NETtel 1500 support' CONFIG_NETtel
	bool 'Telos Omnia ToolVox support' CONFIG_TELOS
fi

if [ "$CONFIG_M5307" = "y" ]; then
	define_bool CONFIG_COLDFIRE y
	bool 'Arnewsh 5307 eval board support' CONFIG_ARNEWSH
	bool 'Moreton Bay NETtel support' CONFIG_NETtel
	bool 'Moreton Bay eLIA development board support' CONFIG_eLIA
	bool 'Moreton Bay MATtel support' CONFIG_MATtel
	bool 'Cadre-III eval board support' CONFIG_CADRE3
	bool 'Old mask (broken watchdog timer)' CONFIG_OLDMASK
fi

choice 'Kernel executes from' \
	"RAM	CONFIG_RAMKERNEL \
	 ROM	CONFIG_ROMKERNEL" ROM

endmenu

mainmenu_option next_comment
comment 'General setup'

bool 'PCI bios support' CONFIG_PCI
if [ "$CONFIG_PCI" = "y" ]; then
	bool '    PCI device list support' CONFIG_PCIDEVLIST
fi

bool 'Networking support' CONFIG_NET
bool 'System V IPC' CONFIG_SYSVIPC
bool 'Reduced memory footprint' CONFIG_REDUCED_MEMORY
tristate 'Kernel support for flat binaries' CONFIG_BINFMT_FLAT
# tristate 'Kernel support for a.out binaries' CONFIG_BINFMT_AOUT
# tristate 'Kernel support for ELF binaries' CONFIG_BINFMT_ELF
bool 'Compile kernel as ELF - if your GCC is ELF-GCC' CONFIG_KERNEL_ELF
if [ "$CONFIG_PILOT" = "y" ]; then
	bool 'Display memory usage on Pilot screen' CONFIG_PILOT_MEMORY_DISPLAY
fi
bool 'Console support' CONFIG_CONSOLE
if [ "$CONFIG_CONSOLE" = "y" ]; then
	bool 'Frame buffer' CONFIG_FRAMEBUFFER
	if [ "$CONFIG_PILOT" = "y" -a "$CONFIG_FRAMEBUFFER" = "y" ]; then
		bool 'Pilot console' CONFIG_PILOT_CONSOLE
	fi
fi

endmenu

#
# Block device driver configuration
#
mainmenu_option next_comment
comment 'Floppy, IDE, and other block devices'

tristate 'ROM disk memory block device' CONFIG_BLK_DEV_BLKMEM
# tristate 'Normal floppy disk support' CONFIG_BLK_DEV_FD
bool 'IDE harddisk support' CONFIG_BLK_DEV_IDE
if [ "$CONFIG_BLK_DEV_IDE" = "y" ]; then
  bool '   Include IDE/ATAPI CDROM support' CONFIG_BLK_DEV_IDECD
  bool '   Include IDE/ATAPI TAPE support' CONFIG_BLK_DEV_IDETAPE
  bool '   Include IDE/ATAPI FLOPPY support (new)' CONFIG_BLK_DEV_IDEFLOPPY
fi

comment 'Additional Block/FLASH Devices'

tristate 'Loopback device support' CONFIG_BLK_DEV_LOOP
bool 'Multiple devices driver support' CONFIG_BLK_DEV_MD
if [ "$CONFIG_BLK_DEV_MD" = "y" ]; then
  tristate '   Linear (append) mode' CONFIG_MD_LINEAR
  tristate '   RAID-0 (striping) mode' CONFIG_MD_STRIPED
fi
tristate 'RAM disk support' CONFIG_BLK_DEV_RAM
if [ "$CONFIG_BLK_DEV_RAM" = "y" ]; then
  bool '   Release empty RAM disk blocks' CONFIG_RD_RELEASE_BLOCKS
#  bool '   Initial RAM disk (initrd) support' CONFIG_BLK_DEV_INITRD
fi
tristate 'FLASH device support' CONFIG_DEV_FLASH
if [ "$CONFIG_DEV_FLASH" = "y" ]; then
  bool '   FLASH Block device' CONFIG_BLK_DEV_FLASH
  bool '   FLASH Character device' CONFIG_CHR_DEV_FLASH
fi
endmenu

if [ "$CONFIG_NET" = "y" ]; then
  source net/Config.in
fi

if [ "$CONFIG_NET" = "y" ]; then

mainmenu_option next_comment
comment 'Network device support'

bool 'Network device support' CONFIG_NETDEVICES
if [ "$CONFIG_NETDEVICES" = "y" ]; then
#
# Network device configuration
#
tristate 'Dummy net driver support' CONFIG_DUMMY
tristate 'SLIP (serial line) support' CONFIG_SLIP
if [ "$CONFIG_SLIP" != "n" ]; then
  bool ' CSLIP compressed headers' CONFIG_SLIP_COMPRESSED
  bool ' Keepalive and linefill' CONFIG_SLIP_SMART
  bool ' Six bit SLIP encapsulation' CONFIG_SLIP_MODE_SLIP6
fi
tristate 'PPP (point-to-point) support' CONFIG_PPP
if [ ! "$CONFIG_PPP" = "n" ]; then
  comment 'CCP compressors for PPP are only built as modules.'
fi
tristate 'EQL (serial line load balancing) support' CONFIG_EQUALIZER
bool 'Cirrus Logic cs8900 ethernet' CONFIG_UCCS8900
if [ "$CONFIG_UCCS8900" != "n" ]; then
	bool 'Hardware byte-swapping support for cs8900 ethernet' CONFIG_UCCS8900_HW_SWAP
fi
bool 'SMC 9194 ethernet' CONFIG_SMC9194
bool 'NE2000/NE1000 ISA ethernet' CONFIG_NE2000

if [ "$CONFIG_M68EN302" = "y" ]; then
	bool 'MC68EN302 SCC ethernet' CONFIG_M68EN302_ETHERNET
fi
fi
endmenu
fi

source fs/Config.in

mainmenu_option next_comment
comment 'Character devices'

# tristate 'Parallel printer support' CONFIG_PRINTER
# bool 'Support for user misc device modules' CONFIG_UMISC
if [ "$CONFIG_M68328" = "y" ]; then
	bool '68328 serial support' CONFIG_68328_SERIAL
	if [ "$CONFIG_68328_SERIAL" = "y" ]; then
		bool 'Support RTS/CTS on 68328 serial support' CONFIG_68328_SERIAL_RTS_CTS
	fi
	if [ "$CONFIG_PILOT" = "y" ]; then
		bool '68328 digitizer support' CONFIG_68328_DIGI
	fi
fi

if [ "$CONFIG_M68EZ328" = "y" ]; then
        bool '68328 serial support' CONFIG_68328_SERIAL
	if [ "$CONFIG_68328_SERIAL" = "y" ]; then
		bool 'Support RTS/CTS on 68328 serial support' CONFIG_68328_SERIAL_RTS_CTS
	fi
 	if [ "$CONFIG_M68EZ328ADS" = "y" ]; then
		bool '68681 serial support' CONFIG_68681_SERIAL
	fi
fi

if [ "$CONFIG_M68332" = "y" ]; then
	bool '68332 serial support' CONFIG_68332_SERIAL
fi

if [ "$CONFIG_M68EN302" = "y" ]; then
	bool '68302 serial support' CONFIG_68302_SERIAL
fi

if [ "$CONFIG_COLDFIRE" = "y" ]; then
	bool 'ColdFire serial support' CONFIG_COLDFIRE_SERIAL
	bool '16550 serial support' CONFIG_SERIAL
	bool 'ColdFire MBUS Support' CONFIG_MCF_MBUS
	bool 'Support for TEXT based LCD driver' CONFIG_LCDTXT
	bool 'Support for ColdFire DMA driven LCD driver' CONFIG_LCDDMA
	bool 'Support for ColdFire DMA driven DAC0800 driver' CONFIG_DAC0800
	bool 'Support for ColdFire DMA driven I2S DAC driver' CONFIG_DACI2S
	bool 'Support for ColdFire T6963 driver' CONFIG_T6963
	if [ "$CONFIG_T6963" = "y" ]; then
		bool '   Use PIO mode' CONFIG_T6963_PIO
		if [ "$CONFIG_T6963_PIO" != "y" ]; then
			define_bool CONFIG_T6963_DMA y
		fi
	fi
fi

# bool 'Support for user serial device modules' CONFIG_USERIAL
bool 'Watchdog Timer Support'	CONFIG_WATCHDOG
# if [ "$CONFIG_WATCHDOG" != "n" ]; then
#   bool '   Disable watchdog shutdown on close' CONFIG_WATCHDOG_NOWAYOUT
#   bool '   Software Watchdog' CONFIG_SOFT_WATCHDOG
# fi
endmenu

# mainmenu_option next_comment
# comment 'Sound support'
#
# tristate 'Sound support' CONFIG_SOUND
# endmenu

mainmenu_option next_comment
comment 'Kernel hacking'

# bool 'Debug kmalloc/kfree' CONFIG_DEBUG_MALLOC
bool 'Kernel profiling support' CONFIG_PROFILE
if [ "$CONFIG_PROFILE" = "y" ]; then
  int ' Profile shift count' CONFIG_PROFILE_SHIFT 2
fi
if [ "$CONFIG_COLDFIRE" = "y" ]; then
	bool 'Magic SysRq Key' CONFIG_MAGIC_SYSRQ
	bool 'Panic/Dump to FLASH' CONFIG_DUMPTOFLASH
fi
endmenu
```
